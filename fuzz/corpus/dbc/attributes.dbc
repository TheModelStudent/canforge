VERSION "1.0 every attribute type"

NS_ :

BS_:

BU_: NodeA NodeB

BO_ 700 AttrMessage: 8 NodeA
 SG_ AttrSignal : 0|8@1+ (1,0) [0|255] "" NodeB
 SG_ OtherSignal : 8|8@1+ (1,0) [0|255] "" NodeB

BA_DEF_ "DbInt" INT -100 100;
BA_DEF_ "DbHex" HEX 0 4294967295;
BA_DEF_ "DbFloat" FLOAT -1.5 1.5;
BA_DEF_ "DbString" STRING ;
BA_DEF_ "DbEnum" ENUM "Alpha","Beta","Gamma";
BA_DEF_ BU_ "NodeInt" INT 0 255;
BA_DEF_ BU_ "NodeEnum" ENUM "Master","Slave";
BA_DEF_ BO_ "GenMsgCycleTime" INT 0 65535;
BA_DEF_ BO_ "MsgFloat" FLOAT 0 1000;
BA_DEF_ BO_ "VFrameFormat" ENUM "StandardCAN","ExtendedCAN","StandardCAN_FD","ExtendedCAN_FD";
BA_DEF_ SG_ "GenSigStartValue" FLOAT -1000 1000;
BA_DEF_ SG_ "SigString" STRING ;
BA_DEF_ SG_ "SigEnum" ENUM "Raw","Cooked";
BA_DEF_DEF_ "DbInt" 7;
BA_DEF_DEF_ "DbHex" 255;
BA_DEF_DEF_ "DbFloat" 0.25;
BA_DEF_DEF_ "DbString" "hello";
BA_DEF_DEF_ "DbEnum" "Beta";
BA_DEF_DEF_ "NodeInt" 1;
BA_DEF_DEF_ "NodeEnum" "Slave";
BA_DEF_DEF_ "GenMsgCycleTime" 100;
BA_DEF_DEF_ "MsgFloat" 1.5;
BA_DEF_DEF_ "VFrameFormat" "StandardCAN";
BA_DEF_DEF_ "GenSigStartValue" 0;
BA_DEF_DEF_ "SigString" "";
BA_DEF_DEF_ "SigEnum" "Raw";
BA_ "DbInt" -42;
BA_ "DbHex" 48879;
BA_ "DbFloat" -1.25;
BA_ "DbString" "a database attribute";
BA_ "DbEnum" 2;
BA_ "NodeInt" BU_ NodeA 3;
BA_ "NodeEnum" BU_ NodeA 0;
BA_ "GenMsgCycleTime" BO_ 700 50;
BA_ "MsgFloat" BO_ 700 12.5;
BA_ "GenSigStartValue" SG_ 700 AttrSignal 17.5;
BA_ "SigString" SG_ 700 AttrSignal "signal attribute";
BA_ "SigEnum" SG_ 700 OtherSignal 1;
