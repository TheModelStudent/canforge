VERSION "1.0 multiplexing torture test"

NS_ :

BS_:

BU_: Tester ECM BCM

BO_ 1024 DiagnosticResponse: 8 ECM
 SG_ ResponseKind M : 0|8@1+ (1,0) [0|255] "" Tester
 SG_ VoltageA m1 : 8|16@1+ (0.001,0) [0|65.535] "V" Tester
 SG_ VoltageB m1 : 24|16@1+ (0.001,0) [0|65.535] "V" Tester
 SG_ TemperatureA m2 : 8|8@1+ (1,-40) [-40|215] "degC" Tester
 SG_ TemperatureB m2 : 16|8@1+ (1,-40) [-40|215] "degC" Tester
 SG_ TemperatureC m2 : 24|8@1+ (1,-40) [-40|215] "degC" Tester
 SG_ CounterWide m3 : 8|32@1+ (1,0) [0|4294967295] "" Tester
 SG_ Motorola16 m4 : 15|16@0+ (1,0) [0|65535] "" Tester
 SG_ AlwaysPresent : 56|8@1+ (1,0) [0|255] "" Tester

BO_ 1025 NestedMux: 8 BCM
 SG_ OuterMux M : 0|4@1+ (1,0) [0|15] "" Tester
 SG_ InnerMux m1M : 4|4@1+ (1,0) [0|15] "" Tester
 SG_ LeafOne m0 : 8|16@1+ (1,0) [0|65535] "" Tester
 SG_ LeafTwo m1 : 24|16@1+ (1,0) [0|65535] "" Tester
 SG_ OuterOnly m2 : 8|8@1+ (1,0) [0|255] "" Tester

BO_ 1026 RangeMux: 8 BCM
 SG_ Selector M : 0|8@1+ (1,0) [0|255] "" Tester
 SG_ LowGroup m0 : 8|16@1+ (1,0) [0|65535] "" Tester
 SG_ HighGroup m10 : 8|16@1+ (1,0) [0|65535] "" Tester

CM_ BO_ 1025 "Two levels of multiplexing via SG_MUL_VAL_";
SG_MUL_VAL_ 1025 InnerMux OuterMux 1-1;
SG_MUL_VAL_ 1025 LeafOne InnerMux 0-0, 3-4;
SG_MUL_VAL_ 1025 LeafTwo InnerMux 1-2;
SG_MUL_VAL_ 1025 OuterOnly OuterMux 2-2;
SG_MUL_VAL_ 1026 LowGroup Selector 0-4;
SG_MUL_VAL_ 1026 HighGroup Selector 10-20, 30-30;
