VERSION "1.0 bom"

NS_ :

BS_:

BU_: A

BO_ 10 M: 1 A
 SG_ S : 0|8@1+ (1,0) [0|255] "" Vector__XXX
