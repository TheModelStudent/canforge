VERSION "malformed"

NS_ :

BS_:

BU_: A

BO_ 4294967295 M: 8 A
 SG_ S : 0|8@1+ (1,0) [0|255] "" A
