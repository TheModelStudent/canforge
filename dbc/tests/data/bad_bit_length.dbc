VERSION "malformed"

NS_ :

BS_:

BU_: A

BO_ 10 M: 8 A
 SG_ S : 0|99@1+ (1,0) [0|255] "" A
