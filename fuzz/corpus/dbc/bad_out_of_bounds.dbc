VERSION "malformed"

NS_ :

BS_:

BU_: A

BO_ 10 M: 2 A
 SG_ S : 0|32@1+ (1,0) [0|255] "" A
