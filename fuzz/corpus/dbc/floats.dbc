VERSION "1.0 IEEE float signals"

NS_ :

BS_:

BU_: Sensor Logger

BO_ 300 FloatPair: 8 Sensor
 SG_ PressureIntel : 0|32@1+ (1,0) [0|0] "bar" Logger
 SG_ PressureMotorola : 39|32@0+ (1,0) [0|0] "bar" Logger

BO_ 301 DoubleIntel: 8 Sensor
 SG_ PreciseValue : 0|64@1+ (1,0) [0|0] "m" Logger

BO_ 302 DoubleMotorola: 8 Sensor
 SG_ PreciseValueBE : 7|64@0+ (1,0) [0|0] "m" Logger

BO_ 303 ScaledFloat: 8 Sensor
 SG_ ScaledIeee : 0|32@1+ (2,1) [0|0] "V" Logger
 SG_ PlainInteger : 32|16@1+ (1,0) [0|65535] "" Logger

SIG_VALTYPE_ 300 PressureIntel : 1;
SIG_VALTYPE_ 300 PressureMotorola : 1;
SIG_VALTYPE_ 301 PreciseValue : 2;
SIG_VALTYPE_ 302 PreciseValueBE : 2;
SIG_VALTYPE_ 303 ScaledIeee : 1;
