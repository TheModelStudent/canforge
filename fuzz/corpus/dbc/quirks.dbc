VERSION "1.0 real world quirks"

NS_ :

BS_:

BU_: Steuergeraet 3PMS Vector__XXX

BO_ 2147483904 ExtendedNoFlagCheck: 8 Steuergeraet
 SG_ PlainSignal : 0|8@1+ (1,0) [0|255] "" Vector__XXX

BO_ 200 NoTransmitter: 4 Vector__XXX
 SG_ Value : 0|16@1+ (0.1,0) [0|6553.5] "V" 3PMS

BO_ 201 FdMessage: 24 Steuergeraet
 SG_ WideSignal : 0|64@1+ (1,0) [0|0] "" 3PMS
 SG_ TailSignal : 176|16@1+ (1,0) [0|65535] "" 3PMS

CM_ BO_ 200 "Messwert der Kühlmitteltemperatur in Grad °C"
CM_ SG_ 200 Value "Spannung, gemessen am Steuergeraet"
SIG_VALTYPE_ 201 WideSignal 0
